VERSION ""

NS_ :

BS_:

BU_: ActuatorECU EngineECU

BO_ 20 ActuadorMessage: 4 ActuatorECU
 SG_ ActuatorAccel : 8|16@1+ (1,0) [0|65535] "" Vector__XXX
 SG_ ActuatorPresent : 0|8@1+ (1,0) [0|1] "" Vector__XXX

BO_ 4 EngineMessage: 4 EngineECU
 SG_ EngineRPM : 8|16@1+ (0.1526,0) [0|10000] "RPM" Vector__XXX
 SG_ EnginePresent : 0|8@1+ (1,0) [0|1] "" Vector__XXX

EV_ envAccel: 0 [0|65535] "" 0 1 DUMMY_NODE_VECTOR0 Vector__XXX;

EV_ envRPM: 0 [0|65535] "" 0 2 DUMMY_NODE_VECTOR0 Vector__XXX;
